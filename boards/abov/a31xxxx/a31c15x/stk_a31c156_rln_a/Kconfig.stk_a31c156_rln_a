## boards/abov/a31xxxx/a31c15x/stk_a31c156_rln_a/Kconfig.stk_a31c156_rln_a
```kconfig
# Copyright (c) 2026 ABOV Semiconductor Co., Ltd.
# SPDX-License-Identifier: BSD-3-Clause

config BOARD_STK_A31C156_RLN_A
	select SOC_A31C156
```

## boards/abov/stk_a31c156_rln_a/stk_a31c156_rln_a_defconfig
```kconfig
# Copyright (c) 2026 ABOV Semiconductor Co., Ltd.
# SPDX-License-Identifier: BSD-3-Clause

CONFIG_CONSOLE=y
CONFIG_UART_CONSOLE=y
CONFIG_SERIAL=y

CONFIG_GPIO=y
```

## drivers/clock_control/Kconfig.abov32
```kconfig
# Copyright (c) 2026 ABOV Semiconductor Co., Ltd.
# SPDX-License-Identifier: BSD-3-Clause

config CLOCK_CONTROL_ABOV32
	bool "ABOV32 clock control"
	default y
	depends on DT_HAS_ABOV_ABOV32_CCTL_ENABLED
	help
	  Enable driver for ABOV System Control Clock Unit.

if CLOCK_CONTROL_ABOV32

config CLOCK_ABOV32_HSI_FREQUENCY
	int "ABOV32 HSI oscillator frequency (Hz)"
	default 8000000
	help
	  Frequency of the internal high-speed (HSI) oscillator. This is
	  fixed by the SoC and is not described in devicetree.

config CLOCK_ABOV32_LSI_FREQUENCY
	int "ABOV32 LSI oscillator frequency (Hz)"
	default 0
	help
	  Frequency of the internal low-speed (LSI) oscillator, in Hz. Must
	  be set to the value from the SoC datasheet before any LSI-derived
	  clock is used; the default of 0 is a placeholder, not a valid
	  oscillator frequency.

endif # CLOCK_CONTROL_ABOV32
```

## drivers/counter/Kconfig.abov32
```kconfig
# Copyright (c) 2026 ABOV Semiconductor Co., Ltd.
# SPDX-License-Identifier: BSD-3-Clause

config COUNTER_ABOV32
	bool "ABOV32 Free Run Timer counter driver"
	default y
	depends on DT_HAS_ABOV_ABOV32_FRT_ENABLED
	help
	  Enable the driver for the ABOV32 Free Run Timer (FRT) peripheral,
	  built on the ABOV HLL FRT API (hll_frt.h). Runs from the internal
	  32 kHz LSI oscillator; only a single top-value/match channel is
	  supported (no independent alarm channels).
```

## drivers/crc/Kconfig.abov32
```kconfig
# Copyright (c) 2026 ABOV Semiconductor Co., Ltd.
# SPDX-License-Identifier: Apache-2.0

config CRC_DRIVER_ABOV32
	bool "ABOV32 CRC driver"
	default y
	depends on DT_HAS_ABOV_ABOV32_CRC_ENABLED
	select CRC_DRIVER_HAS_CRC8
	select CRC_DRIVER_HAS_CRC16
	select CRC_DRIVER_HAS_CRC16_CCITT
	select CRC_DRIVER_HAS_CRC32_IEEE
	help
	  Enable the hardware CRC driver for ABOV32 SoCs. The IP has a fixed
	  set of hardware polynomials (CRC-8, CRC-16, CRC-16/CCITT and
	  CRC-32/IEEE); there is no user-programmable polynomial register.
```

## drivers/i2c/Kconfig.abov32
```kconfig
# Copyright (c) 2026 ABOV Semiconductor Co., Ltd.
# SPDX-License-Identifier: BSD-3-Clause

config I2C_ABOV32
	bool "ABOV32 I2C driver"
	default y
	depends on DT_HAS_ABOV_ABOV32_I2C_ENABLED
	select PINCTRL
	help
	  Enable the driver for the ABOV32 I2C peripheral, built on the ABOV
	  HLL I2C API (hll_i2c.h). Controller-mode transfers are polling-only;
	  target (slave) mode is interrupt-driven. A single instance supports
	  only one role at a time -- see i2c_abov32.c for why.
```

## drivers/pinctrl/Kconfig.abov32
```kconfig
# SPDX-FileCopyrightText: 2026 ABOV Semiconductor Co., Ltd.
# SPDX-License-Identifier: BSD-3-Clause

config PINCTRL_ABOV32
	bool "ABOV 32-bits Semiconductor pinctrl driver"
	default y
	depends on DT_HAS_ABOV32_PINCTRL_ENABLED
	help
	  Enable pin controller driver for ABOV 32-bits SoCs.
```

## drivers/serial/Kconfig.abov32
```kconfig
# Copyright (c) 2026 ABOV Semiconductor Co., Ltd.
# SPDX-License-Identifier: BSD-3-Clause

config USART_ABOV32
	bool "ABOV32 USART serial driver"
	default y
	depends on DT_HAS_ABOV_ABOV32_USART_ENABLED
	select PINCTRL
	select CLOCK_CONTROL
	select SERIAL_HAS_DRIVER
	select SERIAL_SUPPORT_INTERRUPT
	help
	  Enable the asynchronous (UART mode) driver for the ABOV32 USART
	  peripheral, built on the ABOV HLL USART API (hll_usart.h).

config UART_ABOV32
	bool "ABOV32 UART serial driver"
	default y
	depends on DT_HAS_ABOV_ABOV32_UART_ENABLED
	select PINCTRL
	select CLOCK_CONTROL
	select SERIAL_HAS_DRIVER
	select SERIAL_SUPPORT_INTERRUPT
	help
	  Enable the driver for the ABOV32 UART peripheral, a dedicated
	  16550-style asynchronous UART built on the ABOV HLL UART API
	  (hll_uart.h). Distinct from the ABOV32 USART peripheral (see
	  USART_ABOV32).
```

## drivers/spi/Kconfig.abov32
```kconfig
# Copyright (c) 2026 ABOV Semiconductor Co., Ltd.
# SPDX-License-Identifier: BSD-3-Clause

config SPI_ABOV32
	bool "ABOV32 SPI driver"
	default y
	depends on DT_HAS_ABOV_ABOV32_SPI_ENABLED
	select PINCTRL
	help
	  Enable the driver for the dedicated ABOV32 SPI0/SPI1 peripheral,
	  built on the ABOV HLL SPI API (hll_spi.h). Polling-based; supports
	  both controller and (experimental, CONFIG_SPI_SLAVE) peripheral
	  mode. Distinct from SPI_ABOV32_USART, which runs a USART instance
	  in its SPI mode instead.

config SPI_ABOV32_USART
	bool "ABOV32 USART-as-SPI driver"
	default y
	depends on DT_HAS_ABOV_ABOV32_USART_SPI_ENABLED
	select PINCTRL
	help
	  Enable the driver for an ABOV32 USART peripheral running in its SPI
	  (synchronous) mode, built on the ABOV HLL USART API (hll_usart.h).
	  Polling-based; supports both controller and (experimental,
	  CONFIG_SPI_SLAVE) peripheral mode. There is no dedicated SPI0/SPI1
	  driver instance available on every board, so this reuses one of the
	  otherwise-idle USART instances (USART11/USART12) instead. Native
	  hardware chip-select generation is a no-op on this chip, so use
	  cs-gpios (or no CS at all, e.g. for a loopback test) rather than
	  relying on it.
```

## drivers/watchdog/Kconfig.abov32
```kconfig
# Copyright (c) 2026 ABOV Semiconductor Co., Ltd.
# SPDX-License-Identifier: BSD-3-Clause

config WDT_ABOV32
	bool "ABOV32 watchdog driver"
	default y
	depends on DT_HAS_ABOV_ABOV32_WDT_ENABLED
	help
	  Enable the driver for the ABOV32 watchdog timer peripheral, built on
	  the ABOV HLL WDT API (hll_wdt.h). The counter runs from the internal
	  32 kHz LSI oscillator; count-match (window) mode is not supported.
```

## dts/bindings/counter/abov,abov32-frt.yaml
```yaml
# Copyright (c) 2026 ABOV Semiconductor Co., Ltd.
# SPDX-License-Identifier: BSD-3-Clause

description: |
  ABOV32 Free Run Timer, driven via the ABOV HLL FRT API (hll_frt.h). A
  32-bit up-counter with two modes (CTRL.MODE, per the SVD): "Free-Run
  Timer" (wraps at 0xFFFFFFFF, overflow interrupt) and "Periodic Timer"
  (wraps/reloads at the match register MCNT, match interrupt) -- the driver
  always uses Periodic mode, mapping MCNT directly onto the Counter API's
  top value. There is only one match register, so channel alarms
  (counter_set_channel_alarm()) are not supported.

compatible: "abov,abov32-frt"

include: base.yaml

properties:
  reg:
    required: true

  interrupts:
    required: true

  clocks:
    required: true

  frt-id:
    type: int
    required: true
    description: |
      HAL FRT_ID_e instance index (0 = FRT0).
```

## dts/bindings/crc/abov,abov32-crc.yaml
```yaml
# Copyright (c) 2026 ABOV Semiconductor Co., Ltd.
# SPDX-License-Identifier: BSD-3-Clause

description: |
  ABOV32 CRC (Cyclic Redundancy Check) controller, driven via the ABOV HLL
  CRC register-level API (hll_crc.h). Supports a fixed set of hardware
  polynomials (CRC-8, CRC-16, CRC-16/CCITT, CRC-32) selected per calculation
  by the zephyr,crc driver API; there is no user-programmable polynomial
  register on this IP.

compatible: "abov,abov32-crc"

include: [base.yaml]

properties:
  reg:
    required: true

  clocks:
    required: true

  crc-id:
    type: int
    required: true
    description: |
      HAL CRC_ID_e instance index (0 = CRC0).
```

## dts/bindings/gpio/abov,abov32-gpio.yaml
```yaml
# Copyright (c) 2026 ABOV Semiconductor Co., Ltd.
# SPDX-License-Identifier: BSD-3-Clause

description: |
  ABOV32 Port Control Unit (PCU) GPIO port.

  Each PCU port (A..G) is exposed as one gpio-controller node. The HAL API
  (HLL_PCU_*()/HAL_PCU_*(), see modules/hal/abov32/audk32/Platform/HAL/Include/
  hll_pcu.h) addresses a port by its PCU_ID_e index rather than by register
  address, so port-id -- not reg -- is what the driver actually uses.

compatible: "abov,abov32-gpio"

include: [gpio-controller.yaml, base.yaml]

properties:
  reg:
    required: true

  port-id:
    type: int
    required: true
    description: |
      PCU_ID_e port index this node drives (see
      modules/hal/abov32/audk32/Platform/HAL/Include/type/pcu_type.h):
      0=PCU_ID_A, 1=PCU_ID_B, 2=PCU_ID_C, 3=PCU_ID_D, 4=PCU_ID_E, 5=PCU_ID_F,
      6=PCU_ID_G.

  "#gpio-cells":
    const: 2

gpio-cells:
  - pin
  - flags
```

## dts/bindings/i2c/abov,abov32-i2c.yaml
```yaml
# Copyright (c) 2026 ABOV Semiconductor Co., Ltd.
# SPDX-License-Identifier: BSD-3-Clause

description: |
  ABOV32 I2C controller, driven via the ABOV HLL I2C API (hll_i2c.h).

  Unlike UART/WDT/FRT, this IP has no SCU MCCR clock-source mux: SCLL/SCLH
  always divide the peripheral clock (SystemPeriClock/PCLK) directly, so
  clock-frequency here sets the I2C bus speed, not an input clock.

compatible: "abov,abov32-i2c"

include: [i2c-controller.yaml, pinctrl-device.yaml, base.yaml]

properties:
  reg:
    required: true

  interrupts:
    required: true

  clocks:
    required: true

  i2c-id:
    type: int
    required: true
    description: |
      HAL I2C_ID_e instance index (0 = I2C0, 1 = I2C1).
```

## dts/bindings/serial/abov,abov32-uart.yaml
```yaml
# Copyright (c) 2026 ABOV Semiconductor Co., Ltd.
# SPDX-License-Identifier: BSD-3-Clause

description: |
  ABOV32 UART controller, driven via the ABOV HLL UART API (hll_uart.h).
  This is a dedicated 16550-style asynchronous UART, distinct from the
  ABOV32 USART peripheral (abov,abov32-usart) which also supports
  synchronous and SPI modes.

compatible: "abov,abov32-uart"

include: [uart-controller.yaml, pinctrl-device.yaml, base.yaml]

properties:
  reg:
    required: true

  interrupts:
    required: true

  clocks:
    required: true

  uart-id:
    type: int
    required: true
    description: |
      HAL UART_ID_e instance index (0 = UART0, 1 = UART1, 2 = UART2).
```

## dts/bindings/serial/abov,abov32-usart.yaml
```yaml
# Copyright (c) 2026 ABOV Semiconductor Co., Ltd.
# SPDX-License-Identifier: BSD-3-Clause

description: |
  ABOV32 USART controller, driven in asynchronous (UART) mode via the ABOV
  HAL USART API (hal_usart.h). The same IP also supports synchronous and SPI
  modes, which are not exposed by this binding/driver yet.

compatible: "abov,abov32-usart"

include: [uart-controller.yaml, pinctrl-device.yaml, base.yaml]

properties:
  reg:
    required: true

  interrupts:
    required: true

  clocks:
    required: true

  usart-id:
    type: int
    required: true
    description: |
      HAL USART_ID_e instance index. On A31C15x, 0 = USART10, 1 = USART11,
      2 = USART12.
```

## dts/bindings/spi/abov,abov32-spi.yaml
```yaml
# Copyright (c) 2026 ABOV Semiconductor Co., Ltd.
# SPDX-License-Identifier: BSD-3-Clause

description: |
  ABOV32 dedicated SPI0/SPI1 controller, driven via the ABOV HLL SPI API
  (hll_spi.h). Distinct from a USART instance running in its SPI mode (see
  abov,abov32-usart-spi).

compatible: "abov,abov32-spi"

include: [spi-controller.yaml, pinctrl-device.yaml, base.yaml]

properties:
  reg:
    required: true

  interrupts:
    required: false

  clocks:
    required: true

  spi-id:
    type: int
    required: true
    description: |
      HAL SPI_ID_e instance index (0 = SPI0, 1 = SPI1).
```

## dts/bindings/spi/abov,abov32-usart-spi.yaml
```yaml
# Copyright (c) 2026 ABOV Semiconductor Co., Ltd.
# SPDX-License-Identifier: BSD-3-Clause

description: |
  ABOV32 USART peripheral running in its SPI (synchronous) mode, driven via
  the ABOV HLL USART API (hll_usart.h). This is the SAME physical register
  block as abov,abov32-usart (async UART mode) -- a USART instance can be
  wired up as either compatible in the SoC dtsi, but a board must only
  enable ONE of the two nodes for a given instance, never both, since they
  would otherwise both try to initialize the same hardware.

compatible: "abov,abov32-usart-spi"

include: [spi-controller.yaml, pinctrl-device.yaml, base.yaml]

properties:
  reg:
    required: true

  interrupts:
    required: false

  clocks:
    required: true

  usart-id:
    type: int
    required: true
    description: |
      HAL USART_ID_e instance index (0 = USART10, 1 = USART11, 2 = USART12).
```

## dts/bindings/watchdog/abov,abov32-wdt.yaml
```yaml
# Copyright (c) 2026 ABOV Semiconductor Co., Ltd.
# SPDX-License-Identifier: BSD-3-Clause

description: |
  ABOV32 Watch Dog Timer, driven via the ABOV HLL WDT API (hll_wdt.h). Runs
  from the internal 32 kHz LSI oscillator routed through the MCCR clock mux.
  Count-match (window) mode is not implemented on the IP version used by
  this SoC series -- only a single free-running down-counter with an
  optional reset-on-underflow and an optional underflow interrupt.

compatible: "abov,abov32-wdt"

include: base.yaml

properties:
  reg:
    required: true

  interrupts:
    required: true

  wdt-id:
    type: int
    required: true
    description: |
      HAL WDT_ID_e instance index (0 = WDT0).
```

## soc/abov/abov32/Kconfig
```kconfig
# Copyright (c) 2026 ABOV Semiconductor Co., Ltd.
# SPDX-License-Identifier: BSD-3-Clause

config SOC_FAMILY_ABOV32
	bool

if SOC_FAMILY_ABOV32

rsource "*/Kconfig"

endif # SOC_FAMILY_ABOV32
```

## soc/abov/abov32/a31c15x/Kconfig.soc
```kconfig
# ABOV Semiconductor A31C15x MCU series

# Copyright (c) 2026 ABOV Semiconductor Co., Ltd.
# SPDX-License-Identifier: BSD-3-Clause
#
config SOC_SERIES_A31C15X
	bool
	select SOC_FAMILY_ABOV32

config SOC_SERIES
	default "a31c15x" if SOC_SERIES_A31C15X

config SOC_A31C156
        bool
        select SOC_SERIES_A31C15X 

config SOC
	default "a31c156" if SOC_A31C156
```

## soc/abov/abov32/a31xxxx/a31c15x/Kconfig.defconfig
```kconfig
# ABOV Semiconductor A31C15x MCU series

# Copyright (c) 2026 ABOV Semiconductor Co., Ltd.
# SPDX-License-Identifier: BSD-3-Clause

if SOC_SERIES_A31C15X

config NUM_IRQS
	default 32

config SYS_CLOCK_HW_CYCLES_PER_SEC
	default 48000000

endif # SOC_SERIES_A31C15X
```

## soc/abov/audk32/a31c15x/Kconfig
```kconfig
# ABOV Semiconductor A31C15x MCU series

# Copyright (c) 2026 ABOV Semiconductor Co., Ltd.
# SPDX-License-Identifier: BSD-3-Clause

config SOC_SERIES_A31C15X
	select ARM
	select CPU_CORTEX_M0+
	select SOC_EARLY_INIT_HOOK
```
