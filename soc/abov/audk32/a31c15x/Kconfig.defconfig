## soc/abov/audk32/a31c15x/Kconfig.defconfig
```kconfig
# ABOV Semiconductor A31C15x MCU series

# Copyright (c) 2026 ABOV Semiconductor Co., Ltd.
# SPDX-License-Identifier: BSD-3-Clause

if SOC_SERIES_A31C15X

config NUM_IRQS
	default 32

config NUM_IRQ_PRIO_BITS
	default 2

endif # SOC_SERIES_A31C15X
```
